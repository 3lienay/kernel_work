/dts-v1/;
#include "tegra114.dtsi"  // Seu arquivo minimalista adaptado

/ {
        #address-cells = <0x01>;
        #size-cells = <0x01>;
        compatible = "hp,phobos", "nvidia,dalmore", "nvidia,tegra114";
        model = "HP Slate 21-k100";

        chosen {
            bootargs = "console=ttyS0,115200n8 earlyprintk";
        };


        aliases {
        }

        memory@80000000 {
            device_type = "memory";
            reg = <0x80000000 0x40000000>; // 1GB @ 0x80000000
        };

        pinmux {
                compatible = "nvidia,tegra114-pinmux";
                reg = <0x70000868 0xd4 0x70003000 0x3e4>;
                pinctrl-names = "default";
                pinctrl-0 = <0x01>;

                pinmux {
                        linux,phandle = <0x01>;
                        phandle = <0x01>;

                        clk1_out_pw4 {
                                nvidia,pins = "clk1_out_pw4";
                                nvidia,function = "extperiph1";
                                nvidia,pull = <0x00>;
                                nvidia,tristate = <0x00>;
                                nvidia,enable-input = <0x00>;
                        };

                        dap1_din_pn1 {
                                nvidia,pins = "dap1_din_pn1";
                                nvidia,function = "i2s0";
                                nvidia,pull = <0x00>;
                                nvidia,tristate = <0x01>;
                                nvidia,enable-input = <0x01>;
                        };

                        dap1_dout_pn2 {
                                nvidia,pins = "dap1_dout_pn2\0dap1_fs_pn0\0dap1_sclk_pn3";
                                nvidia,function = "i2s0";
                                nvidia,pull = <0x00>;
                               nvidia,tristate = <0x00>;
                                nvidia,enable-input = <0x01>;
                        };

                        dap2_din_pa4 {
                                nvidia,pins = "dap2_din_pa4";
                                nvidia,function = "i2s1";
                                nvidia,pull = <0x00>;
                                nvidia,tristate = <0x01>;
                                nvidia,enable-input = <0x01>;
                        };

                        dap2_dout_pa5 {
                                nvidia,pins = "dap2_dout_pa5\0dap2_fs_pa2\0dap2_sclk_pa3";
                                nvidia,function = "i2s1";
                                nvidia,pull = <0x00>;
                                nvidia,tristate = <0x00>;
                                nvidia,enable-input = <0x01>;
                        };

                        dap4_din_pp5 {
                                nvidia,pins = "dap4_din_pp5\0dap4_dout_pp6\0dap4_fs_pp4\0dap4_sclk_pp7";
                                nvidia,function = "i2s3";
                                nvidia,pull = <0x00>;
                                nvidia,tristate = <0x00>;
                                nvidia,enable-input = <0x01>;
                        };

                        dvfs_pwm_px0 {
                                nvidia,pins = "dvfs_pwm_px0\0dvfs_clk_px2";
                                nvidia,function = "cldvfs";
                                nvidia,pull = <0x00>;
                                nvidia,tristate = <0x00>;
                                nvidia,enable-input = <0x00>;
                        };

                        ulpi_clk_py0 {
                                nvidia,pins = "ulpi_clk_py0\0ulpi_data0_po1\0ulpi_data1_po2\0ulpi_data2_po3\0ulpi_data3_po4\0ulpi_data4_po>                                nvidia,function = "ulpi";
                                nvidia,pull = <0x00>;
                                nvidia,tristate = <0x00>;
                                nvidia,enable-input = <0x01>;
                        };

                        ulpi_dir_py1 {
                                nvidia,pins = "ulpi_dir_py1\0ulpi_nxt_py2";
                                nvidia,function = "ulpi";
                                nvidia,pull = <0x00>;
                                nvidia,tristate = <0x01>;
                                nvidia,enable-input = <0x01>;
                        };
                        ulpi_stp_py3 {
                                nvidia,pins = "ulpi_stp_py3";
                                nvidia,function = "ulpi";
                                nvidia,pull = <0x00>;
                                nvidia,tristate = <0x00>;
                                nvidia,enable-input = <0x00>;
                        };

                        cam_i2c_scl_pbb1 {
                                nvidia,pins = "cam_i2c_scl_pbb1\0cam_i2c_sda_pbb2";
                                nvidia,function = "i2c3";
                                nvidia,pull = <0x00>;
                                nvidia,tristate = <0x00>;
                                nvidia,enable-input = <0x01>;
                                nvidia,lock = <0x00>;
                                nvidia,open-drain = <0x00>;
                        };

                        cam_mclk_pcc0 {
                                nvidia,pins = "cam_mclk_pcc0\0pbb0";
                                nvidia,function = "vi_alt3";
                                nvidia,pull = <0x00>;
                                nvidia,tristate = <0x00>;
                                nvidia,enable-input = <0x00>;
                                nvidia,lock = <0x00>;
                        };
                       gen2_i2c_scl_pt5 {
                                nvidia,pins = "gen2_i2c_scl_pt5\0gen2_i2c_sda_pt6";
                                nvidia,function = "i2c2";
                                nvidia,pull = <0x00>;
                                nvidia,tristate = <0x00>;
                                nvidia,enable-input = <0x01>;
                                nvidia,lock = <0x00>;
                                nvidia,open-drain = <0x00>;
                        };

                        gmi_a16_pj7 {
                                nvidia,pins = "gmi_a16_pj7";
                                nvidia,function = "uartd";
                                nvidia,pull = <0x00>;
                                nvidia,tristate = <0x00>;
                                nvidia,enable-input = <0x00>;
                        };

                        gmi_a17_pb0 {
                                nvidia,pins = "gmi_a17_pb0\0gmi_a18_pb1";
                                nvidia,function = "uartd";
                                nvidia,pull = <0x00>;
                                nvidia,tristate = <0x01>;
                                nvidia,enable-input = <0x01>;
                        };
                        gmi_a19_pk7 {
                                nvidia,pins = "gmi_a19_pk7";
                                nvidia,function = "uartd";
                                nvidia,pull = <0x00>;
                                nvidia,tristate = <0x00>;
                                nvidia,enable-input = <0x00>;
                        };

                        gmi_ad5_pg5 {
                                nvidia,pins = "gmi_ad5_pg5\0gmi_cs6_n_pi3\0gmi_wr_n_pi0";
                                nvidia,function = "spi4";
                                nvidia,pull = <0x00>;
                                nvidia,tristate = <0x00>;
                                nvidia,enable-input = <0x01>;
                        };

                        gmi_ad6_pg6 {
                                nvidia,pins = "gmi_ad6_pg6\0gmi_ad7_pg7";
                                nvidia,function = "spi4";
                                nvidia,pull = <0x02>;
                                nvidia,tristate = <0x00>;
                                nvidia,enable-input = <0x01>;
                        };

                        gmi_ad12_ph4 {
                                nvidia,pins = "gmi_ad12_ph4";
                                nvidia,function = "rsvd4";
                                nvidia,pull = <0x00>;
                                nvidia,tristate = <0x00>;
                                nvidia,enable-input = <0x00>;
                        };

                        gmi_ad9_ph1 {
                                nvidia,pins = "gmi_ad9_ph1";
                                nvidia,function = "pwm1";
                                nvidia,pull = <0x00>;
                                nvidia,tristate = <0x00>;
                                nvidia,enable-input = <0x00>;
                        };

                        gmi_cs1_n_pj2 {
                                nvidia,pins = "gmi_cs1_n_pj2\0gmi_oe_n_pi1";
                                nvidia,function = "soc";
                                nvidia,pull = <0x00>;
                                nvidia,tristate = <0x01>;
                                nvidia,enable-input = <0x01>;
                        };

                        clk2_out_pw5 {
                                nvidia,pins = "clk2_out_pw5";
                                nvidia,function = "extperiph2";
                                nvidia,pull = <0x00>;
                                nvidia,pull = <0x00>;
                                nvidia,tristate = <0x00>;
                                nvidia,enable-input = <0x00>;
                        };

                        sdmmc1_clk_pz0 {
                                nvidia,pins = "sdmmc1_clk_pz0";
                                nvidia,function = "sdmmc1";
                                nvidia,pull = <0x00>;
                                nvidia,tristate = <0x00>;
                                nvidia,enable-input = <0x01>;
                        };

                        sdmmc1_cmd_pz1 {
                                nvidia,pins = "sdmmc1_cmd_pz1\0sdmmc1_dat0_py7\0sdmmc1_dat1_py6\0sdmmc1_dat2_py5\0sdmmc1_dat3_py4";
                                nvidia,function = "sdmmc1";
                                nvidia,pull = <0x02>;
                                nvidia,tristate = <0x00>;
                                nvidia,enable-input = <0x01>;
                        };

                        sdmmc1_wp_n_pv3 {
                                nvidia,pins = "sdmmc1_wp_n_pv3";
                                nvidia,function = "spi4";
                                nvidia,pull = <0x02>;
                                nvidia,tristate = <0x00>;
                                nvidia,enable-input = <0x00>;
                        };

                        sdmmc3_clk_pa6 {
                                nvidia,pins = "sdmmc3_clk_pa6";
                                nvidia,function = "sdmmc3";
                                nvidia,pull = <0x00>;
                                nvidia,tristate = <0x00>;
                                nvidia,enable-input = <0x01>;
                        };

                        sdmmc3_cmd_pa7 {
                                nvidia,pins = "sdmmc3_cmd_pa7\0sdmmc3_dat0_pb7\0sdmmc3_dat1_pb6\0sdmmc3_dat2_pb5\0sdmmc3_dat3_pb4\0kb_col4>                                nvidia,function = "sdmmc3";
                                nvidia,pull = <0x02>;
                                nvidia,tristate = <0x00>;
                                nvidia,enable-input = <0x01>;
                        };

                        sdmmc4_clk_pcc4 {
                                nvidia,pins = "sdmmc4_clk_pcc4";
                                nvidia,function = "sdmmc4";
                                nvidia,pull = <0x00>;
                                nvidia,tristate = <0x00>;
                                nvidia,enable-input = <0x01>;
                        };
                        sdmmc4_cmd_pt7 {
                                nvidia,pins = "sdmmc4_cmd_pt7\0sdmmc4_dat0_paa0\0sdmmc4_dat1_paa1\0sdmmc4_dat2_paa2\0sdmmc4_dat3_paa3\0sdm>                                nvidia,function = "sdmmc4";
                                nvidia,pull = <0x02>;
                                nvidia,tristate = <0x00>;
                                nvidia,enable-input = <0x01>;
                        };

                        clk_32k_out_pa0 {
                                nvidia,pins = "clk_32k_out_pa0";
                                nvidia,function = "blink";
                                nvidia,pull = <0x00>;
                                nvidia,tristate = <0x00>;
                                nvidia,enable-input = <0x00>;
                        };

                        kb_col0_pq0 {
                                nvidia,pins = "kb_col0_pq0\0kb_col1_pq1\0kb_col2_pq2\0kb_row0_pr0\0kb_row1_pr1\0kb_row2_pr2";
                                nvidia,function = "kbc";
                                nvidia,pull = <0x02>;
                                nvidia,tristate = <0x00>;
                                nvidia,enable-input = <0x01>;
                        };

                        dap3_din_pp1 {
                                nvidia,pins = "dap3_din_pp1\0dap3_sclk_pp3";
                                nvidia,function = "displayb";
                                nvidia,pull = <0x00>;
                                nvidia,tristate = <0x01>;
                                nvidia,enable-input = <0x00>;
                        };

                        pv0 {
                                nvidia,pins = "pv0";
                                nvidia,function = "rsvd4";
                                nvidia,pull = <0x00>;
                                nvidia,tristate = <0x01>;
                                nvidia,enable-input = <0x00>;
                        };

                        kb_row7_pr7 {
                                nvidia,pins = "kb_row7_pr7";
                                nvidia,function = "rsvd2";
                                nvidia,pull = <0x02>;
                                nvidia,tristate = <0x00>;
                                nvidia,enable-input = <0x01>;
                        };

                        kb_row10_ps2 {
                                nvidia,pins = "kb_row10_ps2";
                                nvidia,function = "uarta";
                                nvidia,pull = <0x00>;
                                nvidia,tristate = <0x01>;
                                nvidia,enable-input = <0x01>;
                        };

                        kb_row9_ps1 {
                                nvidia,pins = "kb_row9_ps1";
                                nvidia,function = "uarta";
                                nvidia,pull = <0x00>;
                                nvidia,tristate = <0x00>;
                                nvidia,enable-input = <0x00>;
                        };

                        pwr_i2c_scl_pz6 {
                                nvidia,pins = "pwr_i2c_scl_pz6\0pwr_i2c_sda_pz7";
                                nvidia,function = "i2cpwr";
                                nvidia,pull = <0x00>;
                                nvidia,tristate = <0x00>;
                                nvidia,enable-input = <0x01>;
                                nvidia,lock = <0x00>;
                                nvidia,open-drain = <0x00>;
                        };

                        sys_clk_req_pz5 {
                                nvidia,pins = "sys_clk_req_pz5";
                                nvidia,function = "sysclk";
                                nvidia,pull = <0x00>;
                                nvidia,tristate = <0x00>;
                                nvidia,enable-input = <0x00>;
                        };

                        core_pwr_req {
                                nvidia,pins = "core_pwr_req";
                                nvidia,function = "pwron";
                                nvidia,pull = <0x00>;
                                nvidia,tristate = <0x00>;
                                nvidia,enable-input = <0x00>;
                        };

                        cpu_pwr_req {
                                nvidia,pins = "cpu_pwr_req";
                                nvidia,function = "cpu";
                                nvidia,pull = <0x00>;
                                nvidia,tristate = <0x00>;
                                nvidia,enable-input = <0x00>;
                        };

                        pwr_int_n {
                                nvidia,pins = "pwr_int_n";
                                nvidia,function = "pmi";
                                nvidia,pull = <0x00>;
                                nvidia,tristate = <0x01>;
                                nvidia,enable-input = <0x01>;
                        };

                        reset_out_n {
                                nvidia,pins = "reset_out_n";
                                nvidia,function = "reset_out_n";
                                nvidia,pull = <0x00>;
                                nvidia,tristate = <0x00>;
                                nvidia,enable-input = <0x00>;
                        };

                        clk3_out_pee0 {
                                nvidia,pins = "clk3_out_pee0";
                                nvidia,function = "extperiph3";
                                nvidia,pull = <0x00>;
                                nvidia,tristate = <0x00>;
                                nvidia,enable-input = <0x00>;
                        };

                        gen1_i2c_scl_pc4 {
                                nvidia,pins = "gen1_i2c_scl_pc4\0gen1_i2c_sda_pc5";
                                nvidia,function = "i2c1";
                                nvidia,pull = <0x00>;
                                nvidia,tristate = <0x00>;
                                nvidia,enable-input = <0x01>;
                                nvidia,lock = <0x00>;
                                nvidia,open-drain = <0x00>;
                        };

                        uart2_cts_n_pj5 {
                                nvidia,pins = "uart2_cts_n_pj5";
                                nvidia,function = "uartb";
                                nvidia,pull = <0x00>;
                                nvidia,tristate = <0x01>;
                                nvidia,enable-input = <0x01>;
                        };

                        uart2_rts_n_pj6 {
                                nvidia,pins = "uart2_rts_n_pj6";
                                nvidia,function = "uartb";
                                nvidia,pull = <0x00>;
                                nvidia,tristate = <0x00>;
                                nvidia,enable-input = <0x00>;
                        };

                        uart2_rxd_pc3 {
                                nvidia,pins = "uart2_rxd_pc3";
                                nvidia,function = "irda";
                                nvidia,pull = <0x00>;
                                nvidia,tristate = <0x01>;
                                nvidia,enable-input = <0x01>;
                        };
                       uart2_txd_pc2 {
                                nvidia,pins = "uart2_txd_pc2";
                                nvidia,function = "irda";
                                nvidia,pull = <0x00>;
                                nvidia,tristate = <0x00>;
                                nvidia,enable-input = <0x00>;
                        };

                        uart3_cts_n_pa1 {
                                nvidia,pins = "uart3_cts_n_pa1\0uart3_rxd_pw7";
                                nvidia,function = "uartc";
                                nvidia,pull = <0x00>;
                                nvidia,tristate = <0x01>;
                                nvidia,enable-input = <0x01>;
                        };

                        uart3_rts_n_pc0 {
                                nvidia,pins = "uart3_rts_n_pc0\0uart3_txd_pw6";
                                nvidia,function = "uartc";
                                nvidia,pull = <0x00>;
                                nvidia,tristate = <0x00>;
                                nvidia,enable-input = <0x00>;
                        };

                        owr {
                                nvidia,pins = "owr";
                                nvidia,function = "owr";
                                nvidia,pull = <0x00>;
                                nvidia,tristate = <0x00>;
                                nvidia,enable-input = <0x01>;
                        };

                        hdmi_cec_pee3 {
                                nvidia,pins = "hdmi_cec_pee3";
                                nvidia,function = "cec";
                                nvidia,pull = <0x00>;
                                nvidia,tristate = <0x00>;
                                nvidia,enable-input = <0x01>;
                                nvidia,lock = <0x00>;
                                nvidia,open-drain = <0x00>;
                        };

                        ddc_scl_pv4 {
                                nvidia,pins = "ddc_scl_pv4\0ddc_sda_pv5";
                                nvidia,function = "i2c4";
                                nvidia,pull = <0x00>;
                                nvidia,tristate = <0x00>;
                                nvidia,enable-input = <0x01>;
                                nvidia,lock = <0x00>;
                                nvidia,rcv-sel = <0x01>;
                        };
                        spdif_in_pk6 {
                                nvidia,pins = "spdif_in_pk6";
                                nvidia,function = "usb";
                                nvidia,pull = <0x02>;
                                nvidia,tristate = <0x00>;
                                nvidia,enable-input = <0x01>;
                                nvidia,lock = <0x00>;
                        };

                        usb_vbus_en0_pn4 {
                                nvidia,pins = "usb_vbus_en0_pn4";
                                nvidia,function = "usb";
                                nvidia,pull = <0x02>;
                                nvidia,tristate = <0x00>;
                                nvidia,enable-input = <0x01>;
                                nvidia,lock = <0x00>;
                                nvidia,open-drain = <0x01>;
                        };

                        gpio_x6_aud_px6 {
                                nvidia,pins = "gpio_x6_aud_px6";
                                nvidia,function = "spi6";
                                nvidia,pull = <0x02>;
                                nvidia,tristate = <0x01>;
                                nvidia,enable-input = <0x01>;
                        };
                       gpio_x4_aud_px4 {
                                nvidia,pins = "gpio_x4_aud_px4\0gpio_x7_aud_px7";
                                nvidia,function = "rsvd1";
                                nvidia,pull = <0x01>;
                                nvidia,tristate = <0x00>;
                                nvidia,enable-input = <0x00>;
                        };

                        gpio_x5_aud_px5 {
                                nvidia,pins = "gpio_x5_aud_px5";
                                nvidia,function = "rsvd1";
                                nvidia,pull = <0x02>;
                                nvidia,tristate = <0x00>;
                                nvidia,enable-input = <0x01>;
                        };

                        gpio_w2_aud_pw2 {
                                nvidia,pins = "gpio_w2_aud_pw2";
                                nvidia,function = "rsvd2";
                                nvidia,pull = <0x02>;
                                nvidia,tristate = <0x00>;
                                nvidia,enable-input = <0x01>;
                        };

                        gpio_w3_aud_pw3 {
                                nvidia,pins = "gpio_w3_aud_pw3";
                                nvidia,function = "spi6";
                                nvidia,pull = <0x02>;
                                nvidia,tristate = <0x00>;
                                nvidia,enable-input = <0x01>;
                        };

                        gpio_x1_aud_px1 {
                                nvidia,pins = "gpio_x1_aud_px1";
                                nvidia,function = "rsvd4";
                                nvidia,pull = <0x01>;
                                nvidia,tristate = <0x00>;
                                nvidia,enable-input = <0x01>;
                        };

                        gpio_x3_aud_px3 {
                                nvidia,pins = "gpio_x3_aud_px3";
                                nvidia,function = "rsvd4";
                                nvidia,pull = <0x02>;
                                nvidia,tristate = <0x00>;
                                nvidia,enable-input = <0x01>;
                        };

                        dap3_fs_pp0 {
                                nvidia,pins = "dap3_fs_pp0";
                                nvidia,function = "i2s2";
                                nvidia,pull = <0x01>;
                                nvidia,tristate = <0x00>;
                                nvidia,enable-input = <0x00>;
                        };

                        dap3_dout_pp2 {
                                nvidia,pins = "dap3_dout_pp2";
                                nvidia,function = "i2s2";
                                nvidia,pull = <0x01>;
                                nvidia,tristate = <0x00>;
                                nvidia,enable-input = <0x00>;
                        };

                        pv1 {
                                nvidia,pins = "pv1";
                                nvidia,function = "rsvd1";
                                nvidia,pull = <0x00>;
                                nvidia,tristate = <0x00>;
                                nvidia,enable-input = <0x01>;
                        };

                        pbb3 {
                                nvidia,pins = "pbb3\0pbb5\0pbb6\0pbb7";
                                nvidia,function = "rsvd4";
                                nvidia,pull = <0x01>;
                                nvidia,tristate = <0x00>;
                                nvidia,enable-input = <0x00>;
                       };

                        pcc1 {
                                nvidia,pins = "pcc1\0pcc2";
                                nvidia,function = "rsvd4";
                                nvidia,pull = <0x01>;
                                nvidia,tristate = <0x00>;
                                nvidia,enable-input = <0x01>;
                        };

                        gmi_ad0_pg0 {
                                nvidia,pins = "gmi_ad0_pg0\0gmi_ad1_pg1";
                                nvidia,function = "gmi";
                                nvidia,pull = <0x00>;
                                nvidia,tristate = <0x00>;
                                nvidia,enable-input = <0x00>;
                        };

                        gmi_ad10_ph2 {
                                nvidia,pins = "gmi_ad10_ph2\0gmi_ad11_ph3\0gmi_ad13_ph5\0gmi_ad8_ph0\0gmi_clk_pk1";
                                nvidia,function = "gmi";
                                nvidia,pull = <0x01>;
                                nvidia,tristate = <0x00>;
                                nvidia,enable-input = <0x00>;
                        };
                       gmi_ad2_pg2 {
                                nvidia,pins = "gmi_ad2_pg2\0gmi_ad3_pg3";
                                nvidia,function = "gmi";
                                nvidia,pull = <0x00>;
                                nvidia,tristate = <0x00>;
                                nvidia,enable-input = <0x01>;
                        };

                        gmi_adv_n_pk0 {
                                nvidia,pins = "gmi_adv_n_pk0\0gmi_cs0_n_pj0\0gmi_cs2_n_pk3\0gmi_cs4_n_pk2\0gmi_cs7_n_pi6\0gmi_dqs_p_pj3\0g>                                nvidia,function = "gmi";
                                nvidia,pull = <0x02>;
                                nvidia,tristate = <0x00>;
                                nvidia,enable-input = <0x01>;
                        };

                        gmi_cs3_n_pk4 {
                                nvidia,pins = "gmi_cs3_n_pk4";
                                nvidia,function = "gmi";
                                nvidia,pull = <0x02>;
                                nvidia,tristate = <0x00>;
                                nvidia,enable-input = <0x00>;
                        };

                        clk2_req_pcc5 {
                                nvidia,pins = "clk2_req_pcc5";
                                nvidia,function = "rsvd4";
                                nvidia,pull = <0x00>;
                                nvidia,tristate = <0x00>;
                                nvidia,enable-input = <0x00>;
                        };

                        kb_col3_pq3 {
                                nvidia,pins = "kb_col3_pq3\0kb_col6_pq6\0kb_col7_pq7";
                                nvidia,function = "kbc";
                                nvidia,pull = <0x02>;
                                nvidia,tristate = <0x00>;
                                nvidia,enable-input = <0x00>;
                        };

                        kb_col5_pq5 {
                                nvidia,pins = "kb_col5_pq5";
                                nvidia,function = "kbc";
                                nvidia,pull = <0x02>;
                                nvidia,tristate = <0x00>;
                                nvidia,enable-input = <0x01>;
                        };

                        kb_row3_pr3 {
                                nvidia,pins = "kb_row3_pr3\0kb_row4_pr4\0kb_row6_pr6\0kb_row8_ps0";
                                nvidia,function = "kbc";
                                nvidia,pull = <0x01>;
                                nvidia,tristate = <0x00>;
                                nvidia,enable-input = <0x01>;
                        };

                        clk3_req_pee1 {
                                nvidia,pins = "clk3_req_pee1";
                                nvidia,function = "rsvd4";
                                nvidia,pull = <0x00>;
                                nvidia,tristate = <0x00>;
                                nvidia,enable-input = <0x00>;
                        };

                        pu4 {
                                nvidia,pins = "pu4";
                                nvidia,function = "displayb";
                                nvidia,pull = <0x00>;
                                nvidia,tristate = <0x00>;
                                nvidia,enable-input = <0x00>;
                        };

                        pu5 {
                                nvidia,pins = "pu5\0pu6";
                                nvidia,function = "displayb";
                                nvidia,pull = <0x00>;
                                nvidia,tristate = <0x00>;
                                nvidia,enable-input = <0x01>;
                       };

                        hdmi_int_pn7 {
                                nvidia,pins = "hdmi_int_pn7";
                                nvidia,function = "rsvd1";
                                nvidia,pull = <0x01>;
                                nvidia,tristate = <0x00>;
                                nvidia,enable-input = <0x01>;
                        };

                        clk1_req_pee2 {
                                nvidia,pins = "clk1_req_pee2\0usb_vbus_en1_pn5";
                                nvidia,function = "rsvd4";
                                nvidia,pull = <0x01>;
                                nvidia,tristate = <0x01>;
                                nvidia,enable-input = <0x00>;
                        };

                        drive_sdio1 {
                                nvidia,pins = "drive_sdio1";
                                nvidia,high-speed-mode = <0x01>;
                                nvidia,schmitt = <0x00>;
                                nvidia,low-power-mode = <0x03>;
                                nvidia,pull-down-strength = <0x24>;
                                nvidia,pull-up-strength = <0x14>;
                                nvidia,slew-rate-rising = <0x02>;
                                nvidia,slew-rate-falling = <0x02>;
                        };

                        drive_sdio3 {
                                nvidia,pins = "drive_sdio3";
                                nvidia,high-speed-mode = <0x01>;
                                nvidia,schmitt = <0x00>;
                                nvidia,low-power-mode = <0x03>;
                                nvidia,pull-down-strength = <0x16>;
                                nvidia,pull-up-strength = <0x24>;
                                nvidia,slew-rate-rising = <0x00>;
                                nvidia,slew-rate-falling = <0x00>;
                        };

                                                drive_gma {
                                nvidia,pins = "drive_gma";
                                nvidia,high-speed-mode = <0x01>;
                                nvidia,schmitt = <0x00>;
                                nvidia,low-power-mode = <0x03>;
                                nvidia,pull-down-strength = <0x02>;
                                nvidia,pull-up-strength = <0x01>;
                                nvidia,slew-rate-rising = <0x00>;
                                nvidia,slew-rate-falling = <0x00>;
                                nvidia,drive-type = <0x01>;
                        };
                };
        };

 {
        backlight: backlight {
                compatible = "pwm-backlight";
                pwms = <&pwm 0 5000000>;
                brightness-levels = <0 4 8 16 32 64 128 255>;
                default-brightness-level = <6>;
        };

        display-panel {
                compatible = "hp,slate21-panel";
                enable-gpios = <&gpio TEGRA_GPIO(H, 3) GPIO_ACTIVE_HIGH>;
                backlight = <&backlight>;
        };

        regulators {
                compatible = "simple-bus";
                #address-cells = <1>;
                #size-cells = <0>;

                vdd_5v: regulator@0 {
                        compatible = "regulator-fixed";
                        reg = <0>;
                        regulator-name = "vdd_5v";
                        regulator-min-microvolt = <5000000>;
                        regulator-max-microvolt = <5000000>;
                };
        };
};
